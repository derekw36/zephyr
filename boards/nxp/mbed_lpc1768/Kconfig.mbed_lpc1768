## boards/nxp/mbed_lpc1768/board.yml
```yaml
board:
  name: mbed_lpc1768
  full_name: mbed NXP LPC1768
  vendor: nxp
  socs:
    - name: lpc1768
```

## drivers/clock_control/Kconfig.lpc17xx
```kconfig
config CLOCK_CONTROL_LPC17XX
	bool "LPC17xx clock control driver"
	default y
	depends on DT_HAS_NXP_LPC17XX_CLOCK_ENABLED
	help
	  Enable the LPC17xx clock control driver.
```

## dts/bindings/clock/nxp,lpc17xx-clock.yaml
```yaml
description: NXP LPC17xx clock controller

compatible: "nxp,lpc17xx-clock"

include: [base.yaml, clock-controller.yaml]

properties:
  "#clock-cells":
    const: 2 # peripheral bit offset, divider value

  clocks:
    required: true

  clock-frequency:
    type: int
    required: true
    description: |
      Final computed frequency of CCLK, used for Zephyr build-time systick rate.

  div-cpu:
    type: int
    required: true
    description: |
      CPU clock divider. The register value will be 1 less than this.
      This produces the final CPU, bus, and peripheral clock.
    min: 1
    max: 256

  div-usb:
    type: int
    required: true
    description: |
      USB clock divider. The register value will be 1 less than this.
      NOTE: The output of this divider must be 48 MHz with a 50% duty cycle.
    min: 1
    max: 16

clock-cells:
  - periph
  - divider
```

## dts/bindings/clock/nxp,lpc17xx-main-pll.yaml
```yaml
description: NXP LPC17xx Main PLL (PLL0)

compatible: "nxp,lpc17xx-main-pll"

include: [base.yaml, clock-controller.yaml]

properties:
  "#clock-cells":
    const: 0

  clocks:
    required: true

  div-n:
    type: int
    required: true
    description: |
      PLL0 Pre-divider value (NSEL0). The register value will be 1 less than this.
    min: 1
    max: 32

  mul-m:
    type: int
    required: true
    description: |
      PLL0 Multiplier value (MSEL0). The register value will be 1 less than this.
    min: 1
    max: 512
```

## dts/bindings/clock/nxp,lpc17xx-usb-pll.yaml
```yaml
description: NXP LPC17xx USB PLL (PLL1)

compatible: "nxp,lpc17xx-usb-pll"

include: [base.yaml, clock-controller.yaml]

properties:
  "#clock-cells":
    const: 0

  clocks:
    required: true

  div-p:
    type: int
    required: true
    description: |
      PLL1 Divider value (PSEL1). The register value will be mapped to a 2-bit ID.
    enum: [1, 2, 4, 8]

  mul-m:
    type: int
    required: true
    description: |
      PLL1 Multiplier value (MSEL1). The register value will be 1 less than this.
    min: 1
    max: 32
```

## modules/Kconfig.lpcopen
```kconfig
config ZEPHYR_LPCOPEN_MODULE
	bool

config HAS_LPCOPEN
	bool
	depends on SOC_SERIES_LPC17XX
	select CMSIS_CORE_HAS_SYSTEM_CORE_CLOCK

if HAS_LPCOPEN

config USE_LPCOPEN_ADC
	bool

config USE_LPCOPEN_CAN
	bool

config USE_LPCOPEN_CMP
	bool

config USE_LPCOPEN_CRC
	bool

config USE_LPCOPEN_DAC
	bool

config USE_LPCOPEN_EEPROM
	bool

config USE_LPCOPEN_EMC
	bool

config USE_LPCOPEN_ENET
	bool

config USE_LPCOPEN_GPDMA
	bool

config USE_LPCOPEN_GPIO
	bool

config USE_LPCOPEN_I2C
	bool

config USE_LPCOPEN_I2S
	bool

config USE_LPCOPEN_IAP
	bool

config USE_LPCOPEN_IOCON
	bool

config USE_LPCOPEN_LCD
	bool

config USE_LPCOPEN_PMU
	bool

config USE_LPCOPEN_RING_BUFFER
	bool

config USE_LPCOPEN_RITIMER
	bool

config USE_LPCOPEN_RTC
	bool

config USE_LPCOPEN_SDC
	bool

config USE_LPCOPEN_SDMMC
	bool

config USE_LPCOPEN_SPI
	bool

config USE_LPCOPEN_SSP
	bool

config USE_LPCOPEN_TIMER
	bool

config USE_LPCOPEN_UART
	bool

config USE_LPCOPEN_WWDT
	bool

endif # HAS_LPCOPEN
```

## soc/nxp/lpc/lpc176x/Kconfig
```kconfig
# SPDX-License-Identifier: Apache-2.0

config SOC_SERIES_LPC176X
	select ARM
	select CPU_CORTEX_M3
```

## soc/nxp/lpc/lpc176x/Kconfig.soc
```kconfig
# SPDX-License-Identifier: Apache-2.0

config SOC_SERIES_LPC176X
	bool
	select SOC_FAMILY_LPC

config SOC_SERIES
	default "lpc176x" if SOC_SERIES_LPC176X

config SOC_LPC1769
	bool
	select SOC_SERIES_LPC176X

config SOC_LPC1768
	bool
	select SOC_SERIES_LPC176X

config SOC_LPC1767
	bool
	select SOC_SERIES_LPC176X

config SOC_LPC1766
	bool
	select SOC_SERIES_LPC176X

config SOC_LPC1765
	bool
	select SOC_SERIES_LPC176X

config SOC_LPC1764
	bool
	select SOC_SERIES_LPC176X

config SOC_LPC1763
	bool
	select SOC_SERIES_LPC176X

config SOC
	default "lpc1769" if SOC_LPC1769
	default "lpc1768" if SOC_LPC1768
	default "lpc1767" if SOC_LPC1767
	default "lpc1766" if SOC_LPC1766
	default "lpc1765" if SOC_LPC1765
	default "lpc1764" if SOC_LPC1764
	default "lpc1763" if SOC_LPC1763

config SOC_PART_NUMBER_LPC1769FBD100
	bool
config SOC_PART_NUMBER_LPC1768FBD100
	bool
config SOC_PART_NUMBER_LPC1768FET100
	bool
config SOC_PART_NUMBER_LPC1768UK
	bool
config SOC_PART_NUMBER_LPC1767FBD100
	bool
config SOC_PART_NUMBER_LPC1766FBD100
	bool
config SOC_PART_NUMBER_LPC1765FBD100
	bool
config SOC_PART_NUMBER_LPC1765FET100
	bool
config SOC_PART_NUMBER_LPC1764FBD100
	bool
config SOC_PART_NUMBER_LPC1763FBD100
	bool

config SOC_PART_NUMBER
	default "LPC1769FBD100" if SOC_PART_NUMBER_LPC1769FBD100
	default "LPC1768FBD100" if SOC_PART_NUMBER_LPC1768FBD100
	default "LPC1768FET100" if SOC_PART_NUMBER_LPC1768FET100
	default "LPC1768UK" if SOC_PART_NUMBER_LPC1768UK
	default "LPC1767FBD100" if SOC_PART_NUMBER_LPC1767FBD100
	default "LPC1766FBD100" if SOC_PART_NUMBER_LPC1766FBD100
	default "LPC1765FBD100" if SOC_PART_NUMBER_LPC1765FBD100
	default "LPC1765FET100" if SOC_PART_NUMBER_LPC1765FET100
	default "LPC1764FBD100" if SOC_PART_NUMBER_LPC1764FBD100
	default "LPC1763FBD100" if SOC_PART_NUMBER_LPC1763FBD100
```

## soc/nxp/lpc/lpc17xx/Kconfig
```kconfig
config SOC_SERIES_LPC17XX
	select CPU_CORTEX_M3
	select CPU_HAS_ARM_MPU
	select SOC_EARLY_INIT_HOOK
	select CLOCK_CONTROL_FIXED_RATE_CLOCK
	select SYSCON
	select HAS_LPCOPEN
	select LPC_PATCH_CHECKSUM
```

## soc/nxp/lpc/lpc17xx/Kconfig.defconfig
```kconfig
if SOC_SERIES_LPC17XX

DT_NVIC_PATH := $(dt_nodelabel_path,nvic)
DT_NVIC_MAX_IRQN := $(dt_highest_controller_irq_number,$(DT_NVIC_PATH),irq)

config NUM_IRQS
	default $(inc,$(DT_NVIC_MAX_IRQN)) if $(dt_path_enabled,$(DT_NVIC_PATH))

config SYS_CLOCK_HW_CYCLES_PER_SEC
	default 4000000 if SOC_LPC1768

config FLASH_SIZE
	default 512 if SOC_LPC1768

endif # SOC_SERIES_LPC17XX
```

## soc/nxp/lpc/lpc17xx/Kconfig.soc
```kconfig
config SOC_SERIES_LPC17XX
	bool
	select SOC_FAMILY_LPC

config SOC_SERIES
	default "lpc17xx" if SOC_SERIES_LPC17XX

config SOC_LPC1768
	bool
	select SOC_SERIES_LPC17XX

config SOC
	default "lpc1768" if SOC_LPC1768

config SOC_PART_NUMBER_LPC1768FBD100
	bool
	select SOC_LPC1768

config SOC_PART_NUMBER_LPC1768FET100
	bool
	select SOC_LPC1768

config SOC_PART_NUMBER_LPC1768UK
	bool
	select SOC_LPC1768

config SOC_PART_NUMBER
	default "LPC1768FBD100" if SOC_PART_NUMBER_LPC1768FBD100
	default "LPC1768FET100" if SOC_PART_NUMBER_LPC1768FET100
	default "LPC1768UK" if SOC_PART_NUMBER_LPC1768UK
```
