#include <nxp/lpc/nxp_lpc17xx.dtsi>

/ {
	sram1: memory@20080000 {
		compatible = "zephyr,memory-region", "mmio-sram";
		reg = <0x20080000 DT_SIZE_K(16)>;
		zephyr,memory-region = "SRAM1";
	};
};

&sram {
	reg = <0x10000000 DT_SIZE_K(32)>;
};
